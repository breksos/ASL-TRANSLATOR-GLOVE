## firmware/idf/asl_csv_logger/sdkconfig.defaults
```kconfig
CONFIG_IDF_TARGET="esp32"
CONFIG_IDF_TARGET_ESP32=y

# CSV at 6 * 50 Hz needs the high baud or we drop bytes.
CONFIG_ESP_CONSOLE_UART_BAUDRATE=921600

CONFIG_COMPILER_OPTIMIZATION_PERF=y
CONFIG_FREERTOS_HZ=1000
CONFIG_ESP_TASK_WDT_TIMEOUT_S=10
CONFIG_PARTITION_TABLE_SINGLE_APP=y

# Quiet the IDF logger so its output doesn't interleave with CSV rows.
CONFIG_LOG_DEFAULT_LEVEL_WARN=y
CONFIG_LOG_DEFAULT_LEVEL=2
```

## firmware/idf/asl_finger_sender/sdkconfig.defaults
```kconfig
# XIAO ESP32-C3 — one per finger
CONFIG_IDF_TARGET="esp32c3"
CONFIG_IDF_TARGET_ESP32C3=y

# Performance over size for the 50 Hz loop
CONFIG_COMPILER_OPTIMIZATION_PERF=y

# 1 ms FreeRTOS tick so vTaskDelay can resolve a 20 ms period cleanly
CONFIG_FREERTOS_HZ=1000

# Stronger watchdog tolerance — the busy-wait spin at the end of the deadline
# scheduler is short but should never trip the IWDT.
CONFIG_ESP_TASK_WDT_TIMEOUT_S=10

CONFIG_PARTITION_TABLE_SINGLE_APP=y
```

## firmware/idf/asl_hand_receiver/sdkconfig.defaults
```kconfig
# ESP32 DevKit1 — on back of hand
CONFIG_IDF_TARGET="esp32"
CONFIG_IDF_TARGET_ESP32=y

# High serial baud — the live PRY/stat output is too verbose for 115200 and
# blocking serial writes would jitter the palm IMU sampling.
CONFIG_ESP_CONSOLE_UART_BAUDRATE=921600

CONFIG_COMPILER_OPTIMIZATION_PERF=y
CONFIG_FREERTOS_HZ=1000
CONFIG_ESP_TASK_WDT_TIMEOUT_S=10
CONFIG_PARTITION_TABLE_SINGLE_APP=y
```

## firmware/idf/i2c_scan/sdkconfig.defaults
```kconfig
CONFIG_IDF_TARGET="esp32c3"
CONFIG_IDF_TARGET_ESP32C3=y
CONFIG_PARTITION_TABLE_SINGLE_APP=y
```

## firmware/idf/pinky_test/sdkconfig.defaults
```kconfig
CONFIG_IDF_TARGET="esp32c3"
CONFIG_IDF_TARGET_ESP32C3=y
CONFIG_COMPILER_OPTIMIZATION_PERF=y
CONFIG_FREERTOS_HZ=1000
CONFIG_ESP_TASK_WDT_TIMEOUT_S=10
CONFIG_PARTITION_TABLE_SINGLE_APP=y
```

## firmware/idf/print_mac/sdkconfig.defaults
```kconfig
# Default target: XIAO ESP32-C3 (sender boards). For the ESP32 DevKit1, run
#   idf.py set-target esp32
# before building.
CONFIG_IDF_TARGET="esp32c3"
CONFIG_IDF_TARGET_ESP32C3=y
CONFIG_PARTITION_TABLE_SINGLE_APP=y
```
